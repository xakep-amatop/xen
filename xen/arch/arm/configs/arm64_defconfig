## xen/arch/arm/configs/arm64_defconfig
```kconfig
CONFIG_UNSUPPORTED=y
CONFIG_SYSTEM_SUSPEND=y
CONFIG_IPMMU_VMSA=y
CONFIG_HAS_SCIF=y
CONFIG_EXPERT=y
CONFIG_ARM_SMMU_V3=y
CONFIG_HAS_ITS=y
CONFIG_GICV3_ESPI=y
```

## xen/arch/arm/configs/xt_defconfig
```kconfig
CONFIG_XSM=y
CONFIG_TEE=y
CONFIG_OPTEE=y
CONFIG_IPMMU_VMSA=y
CONFIG_IOREQ_SERVER=y
CONFIG_EXPERT=y

CONFIG_UNSUPPORTED=y

CONFIG_EARLY_UART_CHOICE_SCIF=y
CONFIG_EARLY_UART_SCIF=y
CONFIG_EARLY_PRINTK=y
CONFIG_EARLY_UART_BASE_ADDRESS=0xe6540000
CONFIG_EARLY_UART_SCIF_VERSION_NONE=y
```

## xen/arch/arm/cpufreq/Kconfig
```kconfig
config CPUFREQ_SCPI
	bool "Enable cpufreq_scpi driver"
	depends on HAS_CPUFREQ
	help
	  Enable cpufreq_scpi driver. This driver implements CPU
	  frequency scaling mechaninsm via SCPI protocol. It uses
	  mailboxes to communicate with SC-Firmware, which provices
	  SCPI interface to control hardware

config CPUFREQ_IMX
	bool "Enable cpufreq_imx driver"
	depends on HAS_CPUFREQ
	help
	  Enable cpufreg_imx driver. This driver implements CPU
	  frequency scaling for i.MX8 boards. It uses scfw rpc to
	  access hardware resoucers.
```

## xen/arch/arm/thermal/Kconfig
```kconfig
config THERMAL_IMX
	bool "Enable thermal_imx driver"
	depends on HAS_THERMAL
	help
	  Enable thermal_imx driver. This driver implements thermal
	  throttling functionality for i.MX8 boards. It uses scfw rpc
	  to access hardware resoucers.

config THERMAL_DEBUG_DRV
	bool "Enable debug thermal driver"
	depends on HAS_THERMAL
	help
	  Enables debug thermal driver which is controlled by hypfs params.
```
